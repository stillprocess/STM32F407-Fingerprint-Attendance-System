#include "oled.h"
#include "delay.h"
#include "stm32f4xx.h"

//OLED软件I2C引脚
#define OLED_SCL_HIGH()    GPIO_SetBits(GPIOB, GPIO_Pin_15)
#define OLED_SCL_LOW()     GPIO_ResetBits(GPIOB, GPIO_Pin_15)
#define OLED_SDA_HIGH()    GPIO_SetBits(GPIOD, GPIO_Pin_10)
#define OLED_SDA_LOW()     GPIO_ResetBits(GPIOD, GPIO_Pin_10)

//OLED写地址，七位地址为0x3C
#define OLED_WRITE_ADDRESS 0x78

//6x8数字字模：0-9
static const uint8_t Font_Digit[10][6] =
{
    {0x3E, 0x51, 0x49, 0x45, 0x3E, 0x00}, //0
    {0x00, 0x42, 0x7F, 0x40, 0x00, 0x00}, //1
    {0x42, 0x61, 0x51, 0x49, 0x46, 0x00}, //2
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    {0x06, 0x49, 0x49, 0x29, 0x1E, 0x00}  //9
};

//6x8大写英文字母字模：A-Z
static const uint8_t Font_Upper[26][6] =
{
	{0x7E, 0x11, 0x11, 0x11, 0x7E, 0x00}, //A
	{0x7F, 0x49, 0x49, 0x49, 0x36, 0x00}, //B
	{0x3E, 0x41, 0x41, 0x41, 0x22, 0x00}, //C
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	{0x61, 0x51, 0x49, 0x45, 0x43, 0x00}  //Z
};

//6x8小写英文字母字模：a-z
static const uint8_t Font_Lower[26][6] =
{
	{0x20, 0x54, 0x54, 0x54, 0x78, 0x00}, //a
	{0x7F, 0x48, 0x44, 0x44, 0x38, 0x00}, //b
	{0x38, 0x44, 0x44, 0x44, 0x20, 0x00}, //c
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	{0x44, 0x64, 0x54, 0x4C, 0x44, 0x00}  //z
};

// 6x8常用符号字模
static const uint8_t Font_Star[6]      = {0x14, 0x08, 0x3E, 0x08, 0x14, 0x00}; // *
static const uint8_t Font_Minus[6]     = {0x08, 0x08, 0x08, 0x08, 0x08, 0x00}; // -
static const uint8_t Font_Plus[6]      = {0x08, 0x08, 0x3E, 0x08, 0x08, 0x00}; // +
static const uint8_t Font_Colon[6]     = {0x00, 0x36, 0x36, 0x00, 0x00, 0x00}; // :
static const uint8_t Font_Dot[6]       = {0x00, 0x60, 0x60, 0x00, 0x00, 0x00}; // .
static const uint8_t Font_Slash[6]     = {0x20, 0x10, 0x08, 0x04, 0x02, 0x00}; // /
static const uint8_t Font_Underline[6] = {0x40, 0x40, 0x40, 0x40, 0x40, 0x00}; // _
static const uint8_t Font_Equal[6]     = {0x14, 0x14, 0x14, 0x14, 0x14, 0x00}; // =
static const uint8_t Font_Hash[6]      = {0x14, 0x7F, 0x14, 0x7F, 0x14, 0x00}; // #

static const uint8_t Font_Space[6] = {0x00, 0x00, 0x00, 0x00, 0x00, 0x00};

//OLED软件I2C短延时
static void OLED_I2C_Delay(void)
{
	delay_us(5);
}

//产生I2C开始信号
static void OLED_I2C_Start(void)
{
	OLED_SDA_HIGH();
	OLED_SCL_HIGH();
	OLED_I2C_Delay();

	OLED_SDA_LOW();
	OLED_I2C_Delay();

	OLED_SCL_LOW();
}

//产生I2C停止信号
static void OLED_I2C_Stop(void)
{
	OLED_SDA_LOW();
	OLED_SCL_HIGH();
	OLED_I2C_Delay();

	OLED_SDA_HIGH();
	OLED_I2C_Delay();
}

//只产生I2C应答时钟，不检查从机ACK
static void OLED_I2C_WaitAck(void)
{
	//开漏输出高电平表示释放SDA
	OLED_SDA_HIGH();
	OLED_I2C_Delay();

	OLED_SCL_HIGH();
	OLED_I2C_Delay();

	OLED_SCL_LOW();
	OLED_I2C_Delay();
}

//通过软件I2C发送一个字节
static void OLED_I2C_WriteByte(uint8_t data)
{
	uint8_t i;

	for(i = 0; i < 8; i++)
	{
		OLED_SCL_LOW();

		//从最高位开始发送
		if((data & 0x80) != 0)
		{
			OLED_SDA_HIGH();
		}
		else
		{
			OLED_SDA_LOW();
		}

		OLED_I2C_Delay();
		OLED_SCL_HIGH();
		OLED_I2C_Delay();

		data <<= 1;
	}

	OLED_SCL_LOW();
}

//向OLED发送命令或显示数据
static void OLED_WriteByte(uint8_t data, uint8_t type)
{
	OLED_I2C_Start();

	//发送OLED写地址
	OLED_I2C_WriteByte(OLED_WRITE_ADDRESS);
	OLED_I2C_WaitAck();

	//0x00表示命令，0x40表示显示数据
	if(type == OLED_DATA)
	{
		OLED_I2C_WriteByte(0x40);
	}
	else
	{
		OLED_I2C_WriteByte(0x00);
	}
	OLED_I2C_WaitAck();

	//发送命令或显示数据
	OLED_I2C_WriteByte(data);
	OLED_I2C_WaitAck();

	OLED_I2C_Stop();
}

//根据字符取得6x8字模
static const uint8_t *OLED_GetFont(uint8_t chr)
{
    if((chr >= '0') && (chr <= '9'))
    {
        return Font_Digit[chr - '0'];
    }

    if((chr >= 'A') && (chr <= 'Z'))
    {
        return Font_Upper[chr - 'A'];
    }

    if((chr >= 'a') && (chr <= 'z'))
    {
        return Font_Lower[chr - 'a'];
    }

    if(chr == '*')
    {
        return Font_Star;
    }

    if(chr == '-')
    {
        return Font_Minus;
    }

    if(chr == '+')
    {
        return Font_Plus;
    }

    if(chr == ':')
    {
        return Font_Colon;
    }

    if(chr == '.')
    {
        return Font_Dot;
    }

    if(chr == '/')
    {
        return Font_Slash;
    }

    if(chr == '_')
    {
        return Font_Underline;
    }

    if(chr == '=')
    {
        return Font_Equal;
    }

    if(chr == '#')
    {
        return Font_Hash;
    }

    if(chr == ' ')
    {
        return Font_Space;
    }

    return Font_Space;
}

//设置OLED显示位置
void OLED_SetPosition(uint8_t x, uint8_t page)
{
	OLED_WriteByte((uint8_t)(0xB0 + page), OLED_CMD);
	OLED_WriteByte((uint8_t)(0x10 | ((x >> 4) & 0x0F)), OLED_CMD);
	OLED_WriteByte((uint8_t)(x & 0x0F), OLED_CMD);
}

//清空OLED屏幕
void OLED_Clear(void)
{
	uint8_t page;
	uint8_t column;

	for(page = 0; page < 8; page++)
	{
		OLED_SetPosition(0, page);

		for(column = 0; column < 128; column++)
		{
			OLED_WriteByte(0x00, OLED_DATA);
		}
	}
}

//清空对应页的内容
void OLED_ClearPage(uint8_t page)
{
	uint8_t column;

	OLED_SetPosition(0, page);

	for(column = 0; column < 128; column++)
	{
		OLED_WriteByte(0x00, OLED_DATA);
	}
}

//显示一个ASCII字符
void OLED_ShowChar(uint8_t x, uint8_t page, uint8_t chr, uint8_t size)
{
	uint8_t i;
	const uint8_t *font;

	//当前阶段只实现6x8字符
	(void)size;
	font = OLED_GetFont(chr);

	OLED_SetPosition(x, page);

	for(i = 0; i < 6; i++)
	{
		OLED_WriteByte(font[i], OLED_DATA);
	}
}

//显示ASCII字符串
void OLED_ShowString(uint8_t x, uint8_t page, const uint8_t *str, uint8_t size)
{
	while(*str != '\0')
	{
		OLED_ShowChar(x, page, *str, size);
		x += 6;

		//超过屏幕宽度后换到下一页
		if(x > 122)
		{
			x = 0;
			page++;
		}

		str++;
	}
}

//初始化SSD1306 OLED
void OLED_Init(void)
{
	GPIO_InitTypeDef GPIO_InitStructure;
	uint8_t i;
	static const uint8_t initCommand[] =
	{
		0xAE,
		0xD5, 0x80,
		0xA8, 0x3F,
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		0xA6,
		0xAF
	};

	//使能GPIOB和GPIOD时钟
	RCC_AHB1PeriphClockCmd(
		RCC_AHB1Periph_GPIOB | RCC_AHB1Periph_GPIOD,
		ENABLE
	);

	//配置PB15为软件I2C时钟引脚
	GPIO_InitStructure.GPIO_Mode  = GPIO_Mode_OUT;
	GPIO_InitStructure.GPIO_Speed = GPIO_Speed_100MHz;
	GPIO_InitStructure.GPIO_OType = GPIO_OType_OD;
	GPIO_InitStructure.GPIO_PuPd  = GPIO_PuPd_UP;
	GPIO_InitStructure.GPIO_Pin   = GPIO_Pin_15;
	GPIO_Init(GPIOB, &GPIO_InitStructure);

	//配置PD10为软件I2C数据引脚
	GPIO_InitStructure.GPIO_Pin = GPIO_Pin_10;
	GPIO_Init(GPIOD, &GPIO_InitStructure);

	//释放软件I2C总线
	OLED_SCL_HIGH();
	OLED_SDA_HIGH();

	//等待OLED上电稳定
	delay_ms(200);

	//发送SSD1306初始化命令
	for(i = 0; i < sizeof(initCommand); i++)
	{
		OLED_WriteByte(initCommand[i], OLED_CMD);
	}
}
